## west.yml
```yaml
# Copyright (c) 2025 Nordic Semiconductor
# SPDX-License-Identifier: LicenseRef-Nordic-5-Clause

manifest:
  self:
    import: submanifests

  remotes:
    - name: ncs
      url-base: https://github.com/nrfconnect
    - name: nfed
      url-base:  https://github.com/circuitdojo

  projects:
    - name: nrf
      remote: ncs
      repo-path: sdk-nrf
      revision: v3.5.0-preview3
      import:
        name-allowlist:
          - cjson
          - cmsis_6
          - cmock
          - hal_nordic
          - libmodem
          - mbedtls
          - mcuboot
          - memfault-firmware-sdk
          - nrfxlib
          - oberon-psa-crypto
          - segger
          - tf-psa-crypto
          - trusted-firmware-m
          - zcbor
          - zephyr
          - littlefs
    - name: nfed
      remote: nfed
      repo-path: nrf9160-feather-examples-and-drivers
      revision: v3.2.x
```
